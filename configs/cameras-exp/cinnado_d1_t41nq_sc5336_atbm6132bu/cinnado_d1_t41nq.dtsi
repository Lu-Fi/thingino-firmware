// Cinnado D1 (T41NQ, SC5336, ATBM6132BU, PTZ) per-board device-tree fragment.
// Injected into the kernel 4.4+ device tree (inject-camera-dtsi.sh).
// LEDs and the reset key come from thingino-leds / gpio-userkeys (defconfig,
// thingino.json), so this fragment carries only the SD card-detect override.

// No SD card-detect pin on this board: msc0 drops the family card-detect
// gpio and cd-inverted (the driver then waits for a pin that does not exist
// and never probes the card) and is polled instead (broken-cd).
&msc0 {
	/delete-property/ cd-inverted;
	/delete-property/ ingenic,cd-gpios;
	broken-cd;
};
